## u-boot/board/generic/mt02_m300_mt9533/Kconfig
```kconfig
if TARGET_MT02_M300_MT9533

config SYS_VENDOR
	default "generic"

config SYS_BOARD
	default "mt02_m300_mt9533"

config SYS_CONFIG_NAME
	default "mt02_m300_mt9533"

config TEXT_BASE
	default 0x9f000000

config SYS_DCACHE_SIZE
	default 32768

config SYS_DCACHE_LINE_SIZE
	default 32

config SYS_ICACHE_SIZE
	default 65536

config SYS_ICACHE_LINE_SIZE
	default 32

endif
```
